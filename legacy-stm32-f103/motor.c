/* Includes ------------------------------------------------------------------*/
#include "motor.h"

void gateClose (void)
{
  /*
  ******************************************************************************
    Check CONDITION. If Close enable - Close
  ******************************************************************************
  */
  if ( (CONDITION & (CLOSE_ENABLE) ) == (CLOSE_ENABLE) )
  {
    /*
    ******************************************************************************
      Disable Motor (for countdown to close)
    ******************************************************************************
    */
    HAL_GPIO_WritePin(GPIOB, MOTOR_ENABLE_Pin, GPIO_PIN_RESET);

    /*
    ******************************************************************************
      Check Motor Open
    ******************************************************************************
    */
    while (! (GPIOB->IDR & MOTOR_OPEN_Pin));

    /*
    ******************************************************************************
      Choose Beep #1 and reset counter
    ******************************************************************************
    */
    beepVariant = 1;
    beepClock = 0;

    /*
    ******************************************************************************
      Close
    ******************************************************************************
    */
    HAL_GPIO_WritePin(GPIOB, MOTOR_CLOSE_Pin, GPIO_PIN_RESET);
  }
}

void gateOpen (void)
{
  /*
  ******************************************************************************
    Check CONDITION. If Open enable - Open
  ******************************************************************************
  */
  if ( (CONDITION & (OPEN_ENABLE) ) == (OPEN_ENABLE) )
  {

    /*
    ******************************************************************************
      Check Motor Close
    ******************************************************************************
    */
    while (! (GPIOB->IDR & MOTOR_CLOSE_Pin));

    /*
    ******************************************************************************
      Open
    ******************************************************************************
    */
    HAL_GPIO_WritePin(GPIOB, MOTOR_OPEN_Pin, GPIO_PIN_RESET);
  }
}

void gateStop (void)
{
  /*
  ******************************************************************************
    Stop. Enable Motor (fuse)
  ******************************************************************************
  */
  HAL_GPIO_WritePin(GPIOB, MOTOR_OPEN_Pin | MOTOR_CLOSE_Pin | MOTOR_ENABLE_Pin, GPIO_PIN_SET);
  
  /*
  ******************************************************************************
    If non-close - set autoclose countdown
  ******************************************************************************
  */
  if (! (GPIOB->IDR & SWITCH_CLOSE_Pin))
  {
    closeTimer = 0;
  }
  else
  {
    closeTimer = CLOSETIMER;
  }

  /*
  
  ******************************************************************************
    Alarm LED - off. Beep - off
  ******************************************************************************
  */
  HAL_GPIO_WritePin (LED1_GPIO_Port, LED1_Pin, GPIO_PIN_RESET);
    if  ((CONDITION & ERROR_BYTE) == ERROR_BYTE)
  {
    beepVariant = 0;
  }
}

void autoClose (void)
{
  /*
  ******************************************************************************
    Check gate position. If close enable - countdown. else - reset timer
  ******************************************************************************
  */
  if ( (CONDITION & (CLOSE_ENABLE) ) == (CLOSE_ENABLE) )
  {
    closeTimer--;
  }
  else
  {
    (closeTimer = CLOSETIMER) ;
  }

  /*
  ******************************************************************************
    Close
  ******************************************************************************
  */
  if (closeTimer == 10)
  {
    closeTimer = 0;
    gateClose () ;
  }
}
