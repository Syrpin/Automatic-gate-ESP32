## gate-controller/components/sim/Kconfig.projbuild
```kconfig
menu "Gate simulator (HIL)"

config GATE_SIM
    bool "Enable hardware-in-the-loop simulator"
    default n
    help
        Runs gate_logic/motor_drv/etc against virtual peripherals:
        USB-UART REPL (status/btn/limit/enc/i/mains/fault) plus the
        Wi-Fi web dashboard. Intended for the bare devkit board with
        nothing wired. NEVER enable in a build that drives real mains.

endmenu
```

## gate-controller/components/storage_nvs/Kconfig.projbuild
```kconfig
menu "Gate regional settings"

choice GATE_MAINS_FREQ_DEFAULT
    bool "Default mains frequency (regional)"
    default GATE_MAINS_AUTO
    help
        Selects the initial value of gate_config.mains_freq on first boot.
        Can always be changed at runtime via NVS / web UI / console ("cfg").
        AUTO measures the zero-cross period and latches 50 or 60 Hz.

    config GATE_MAINS_AUTO
        bool "Auto-detect from zero-cross (safe for any region)"
    config GATE_MAINS_50HZ
        bool "50 Hz (RU/EU/CIS, most of Asia, AU/NZ)"
    config GATE_MAINS_60HZ
        bool "60 Hz (US/CA/MX, JP-west, SA, KR/TW)"
endchoice

choice GATE_CT_DEFAULT
    bool "Default current-sensor variant (first boot)"
    default GATE_CT_ZMCT
    help
        Initial value of gate_config.ct_sensor. DECISION 2026: ZMCT103C
        split-core CT is the PRIMARY sensor (galvanic isolation, zero
        offset drift, cheap; AC-only is fine for pinch/RMS protection and
        battery telemetry was dropped by decision). The Hall front end
        (ACS712/ACS723 class) stays selectable as legacy bring-up fallback
        (devkit / variant-A footprint on custom board v1). Runtime-
        selectable via NVS / web UI / console ("ct") — this choice only
        sets the first-boot default.

    config GATE_CT_ZMCT
        bool "ZMCT103C transformer (burden 2x22R, K_eff=22 mV/A, AC-only) [PRIMARY]"
    config GATE_CT_HALL
        bool "Hall ratiometric (ACS712-30A class, K=66 mV/A, DC-capable) [legacy fallback]"
endchoice

endmenu
```

## gate-controller/components/webui/Kconfig.projbuild
```kconfig
menu "Gate Web UI"

config WEBUI_ENABLE
    bool "Serve embedded web dashboard over Wi-Fi (softAP fallback)"
    depends on GATE_SIM
    default y

config WEBUI_WIFI_SSID
    string "Station SSID (leave empty to start open softAP 'gate-cfg')"
    default ""

config WEBUI_WIFI_PASSWORD
    string "Station password"
    default ""

endmenu
```

## gate-controller/sdkconfig.defaults
```kconfig
# ESP32-S3 N16R8 defaults for gate-controller skeleton
CONFIG_IDF_TARGET="esp32s3"
CONFIG_ESPTOOLPY_FLASHSIZE_16MB=y
CONFIG_ESPTOOLPY_FLASHMODE_QIO=y
CONFIG_ESPTOOLPY_FLASHFREQ_80M=y
CONFIG_SPIRAM=y
CONFIG_SPIRAM_MODE_OCT=y
CONFIG_SPIRAM_SPEED_80M=y
CONFIG_FREERTOS_HZ=1000
CONFIG_ESP_TASK_WDT_TIMEOUT_S=10
CONFIG_ESP_MAIN_TASK_STACK_SIZE=6144
CONFIG_COMPILER_OPTIMIZATION_PERF=y
CONFIG_BOOTLOADER_COMPILER_OPTIMIZATION_SIZE=y
```
